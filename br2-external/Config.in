## linux/Documentation/devicetree/bindings/net/semtech,gn25l95.yaml
```yaml
# SPDX-License-Identifier: (GPL-2.0-only OR BSD-2-Clause)
%YAML 1.2
---
$id: http://devicetree.org/schemas/net/semtech,gn25l95.yaml#
$schema: http://devicetree.org/meta-schemas/core.yaml#

title: Semtech GN25L95 PON laser driver and limiting amplifier

maintainers:
  - Paweł Phan <szop.hektar_1w@icloud.com>

description: |
  A laser driver and limiting amplifier for the optics of passive optical
  network units (ONUs). It runs the ONU's burst-mode transmitter and its
  receiver from the configuration and calibration in an EEPROM of its own,
  and serves the SFF-8472 management interface on I2C: the identification at
  address 0x50 (A0h) and the diagnostics and the part's own tables at 0x51
  (A2h).

  The ONU's MAC names the part as its optics by phandle, and asserts and
  releases its transmit disable as the activation state requires.

properties:
  compatible:
    const: semtech,gn25l95

  reg:
    description:
      The address of the A0h page, normally 0x50. The A2h page is at the next
      address.
    maxItems: 1

  tx-disable-gpios:
    description:
      The hard transmit-disable input. While it is asserted the transmitter
      emits no light.
    maxItems: 1

required:
  - compatible
  - reg

additionalProperties: false

examples:
  - |
    #include <dt-bindings/gpio/gpio.h>

    i2c {
        #address-cells = <1>;
        #size-cells = <0>;

        laser-driver@50 {
            compatible = "semtech,gn25l95";
            reg = <0x50>;
            tx-disable-gpios = <&gpio0 13 GPIO_ACTIVE_HIGH>;
        };
    };
```

## linux/Documentation/devicetree/bindings/watchdog/realtek,rtl9602c-wdt.yaml
```yaml
# SPDX-License-Identifier: (GPL-2.0-only OR BSD-2-Clause)
%YAML 1.2
---
$id: http://devicetree.org/schemas/watchdog/realtek,rtl9602c-wdt.yaml#
$schema: http://devicetree.org/meta-schemas/core.yaml#

title: Realtek RTL9602C watchdog timer

maintainers:
  - Paweł Phan <szop.hektar_1w@icloud.com>

description:
  The watchdog of the Realtek RTL9602C counts ticks of the 200 MHz LX bus
  clock, each 2^25, 2^26, 2^27 or 2^28 cycles long (about 0.17 to 1.34 s),
  through two phases of 1 to 32 ticks each. At the end of phase one it sets a
  flag in its status register; at the end of phase two it resets the whole
  chip, the switch included. Writing its keepalive bit restarts the count.

allOf:
  - $ref: watchdog.yaml#

properties:
  compatible:
    const: realtek,rtl9602c-wdt

  reg:
    maxItems: 1

  interrupts:
    description:
      The warning at the end of phase one. The block sets its status flag
      then, but has not been seen to raise an interrupt.
    maxItems: 1

required:
  - compatible
  - reg

unevaluatedProperties: false

examples:
  - |
    watchdog@18003260 {
        compatible = "realtek,rtl9602c-wdt";
        reg = <0x18003260 0xc>;
        interrupt-parent = <&intc>;
        interrupts = <5>;
    };
```

## linux/arch/mips/configs/rtl9602c_defconfig
```kconfig
# CONFIG_LOCALVERSION_AUTO is not set
# CONFIG_CROSS_MEMORY_ATTACH is not set
CONFIG_LOG_BUF_SHIFT=14
CONFIG_CC_OPTIMIZE_FOR_SIZE=y
CONFIG_LD_DEAD_CODE_DATA_ELIMINATION=y
CONFIG_EXPERT=y
# CONFIG_SGETMASK_SYSCALL is not set
# CONFIG_FHANDLE is not set
# CONFIG_AIO is not set
# CONFIG_IO_URING is not set
# CONFIG_ADVISE_SYSCALLS is not set
# CONFIG_MEMBARRIER is not set
# CONFIG_RSEQ is not set
# CONFIG_CACHESTAT_SYSCALL is not set
CONFIG_RTL9602C=y
# CONFIG_MIPS_FP_SUPPORT is not set
CONFIG_MIPS_CMDLINE_DTB_EXTEND=y
# CONFIG_SUSPEND is not set
# CONFIG_SECCOMP is not set
# CONFIG_STACKPROTECTOR is not set
# CONFIG_COMPAT_32BIT_TIME is not set
# CONFIG_GCC_PLUGINS is not set
# CONFIG_BLOCK_LEGACY_AUTOLOAD is not set
CONFIG_PARTITION_ADVANCED=y
# CONFIG_MSDOS_PARTITION is not set
# CONFIG_EFI_PARTITION is not set
# CONFIG_MQ_IOSCHED_DEADLINE is not set
# CONFIG_MQ_IOSCHED_KYBER is not set
# CONFIG_COREDUMP is not set
# CONFIG_SWAP is not set
CONFIG_SLUB_TINY=y
# CONFIG_COMPAT_BRK is not set
# CONFIG_COMPACTION is not set
# CONFIG_VM_EVENT_COUNTERS is not set
CONFIG_NET=y
CONFIG_PACKET=y
CONFIG_UNIX=y
# CONFIG_AF_UNIX_OOB is not set
CONFIG_INET=y
CONFIG_IP_ADVANCED_ROUTER=y
CONFIG_IP_MULTIPLE_TABLES=y
# CONFIG_INET_DIAG is not set
CONFIG_TCP_CONG_ADVANCED=y
# CONFIG_TCP_CONG_BIC is not set
# CONFIG_TCP_CONG_CUBIC is not set
# CONFIG_TCP_CONG_WESTWOOD is not set
# CONFIG_TCP_CONG_HTCP is not set
# CONFIG_IPV6_SIT is not set
CONFIG_IPV6_MULTIPLE_TABLES=y
CONFIG_BRIDGE=y
CONFIG_BRIDGE_VLAN_FILTERING=y
CONFIG_NET_DSA=y
CONFIG_VLAN_8021Q=y
CONFIG_NET_SCHED=y
CONFIG_NET_SCH_TBF=y
CONFIG_NET_SCH_INGRESS=y
CONFIG_NET_SCH_ETS=y
CONFIG_NET_CLS_FLOWER=y
CONFIG_NET_CLS_MATCHALL=y
CONFIG_NET_CLS_ACT=y
CONFIG_NET_ACT_POLICE=y
CONFIG_NET_ACT_GACT=y
CONFIG_NET_ACT_MIRRED=y
CONFIG_NET_ACT_VLAN=y
CONFIG_DCB=y
# CONFIG_ETHTOOL_NETLINK is not set
CONFIG_DEVTMPFS=y
CONFIG_DEVTMPFS_MOUNT=y
# CONFIG_STANDALONE is not set
# CONFIG_PREVENT_FIRMWARE_BUILD is not set
# CONFIG_FW_LOADER is not set
# CONFIG_ALLOW_DEV_COREDUMP is not set
CONFIG_MTD=y
CONFIG_MTD_BLOCK=y
CONFIG_MTD_SPI_NOR=y
CONFIG_NETDEVICES=y
CONFIG_NET_DSA_RTL9602C=y
CONFIG_RTL9602C_ETH=y
CONFIG_PPP=y
CONFIG_PPPOE=y
# CONFIG_INPUT is not set
# CONFIG_SERIO is not set
# CONFIG_VT is not set
# CONFIG_LEGACY_PTYS is not set
# CONFIG_LEGACY_TIOCSTI is not set
# CONFIG_LDISC_AUTOLOAD is not set
CONFIG_SERIAL_8250=y
# CONFIG_SERIAL_8250_DEPRECATED_OPTIONS is not set
# CONFIG_SERIAL_8250_16550A_VARIANTS is not set
CONFIG_SERIAL_8250_CONSOLE=y
CONFIG_SERIAL_8250_NR_UARTS=1
CONFIG_SERIAL_8250_RUNTIME_UARTS=1
# CONFIG_HW_RANDOM is not set
# CONFIG_DEVPORT is not set
CONFIG_I2C=y
CONFIG_SPI=y
CONFIG_SPI_REALTEK_RTL=y
CONFIG_GPIOLIB=y
# CONFIG_GPIO_CDEV is not set
CONFIG_GPIO_REALTEK_OTTO=y
CONFIG_WATCHDOG=y
CONFIG_WATCHDOG_SYSFS=y
CONFIG_RTL9602C_WATCHDOG=y
# CONFIG_USB_SUPPORT is not set
# CONFIG_VIRTIO_MENU is not set
# CONFIG_VHOST_MENU is not set
# CONFIG_MIPS_PLATFORM_DEVICES is not set
# CONFIG_IOMMU_SUPPORT is not set
# CONFIG_NVMEM is not set
# CONFIG_FILE_LOCKING is not set
# CONFIG_DNOTIFY is not set
# CONFIG_INOTIFY_USER is not set
CONFIG_TMPFS=y
CONFIG_SQUASHFS=y
# CONFIG_SQUASHFS_ZLIB is not set
CONFIG_SQUASHFS_XZ=y
# CONFIG_CRC_OPTIMIZATIONS is not set
# CONFIG_XZ_DEC_X86 is not set
# CONFIG_XZ_DEC_POWERPC is not set
# CONFIG_XZ_DEC_ARM is not set
# CONFIG_XZ_DEC_ARMTHUMB is not set
# CONFIG_XZ_DEC_ARM64 is not set
# CONFIG_XZ_DEC_SPARC is not set
# CONFIG_XZ_DEC_RISCV is not set
CONFIG_PRINTK_TIME=y
CONFIG_DYNAMIC_DEBUG=y
# CONFIG_SYMBOLIC_ERRNAME is not set
# CONFIG_DEBUG_MISC is not set
# CONFIG_SECTION_MISMATCH_WARN_ONLY is not set
CONFIG_MAGIC_SYSRQ=y
CONFIG_DEBUG_FS=y
CONFIG_SOFTLOCKUP_DETECTOR=y
CONFIG_DEFAULT_HUNG_TASK_TIMEOUT=30
# CONFIG_FTRACE is not set
# CONFIG_RUNTIME_TESTING_MENU is not set
```

## linux/drivers/net/dsa/realtek/Kconfig
```kconfig
# SPDX-License-Identifier: GPL-2.0-only
menuconfig NET_DSA_REALTEK
	tristate "Realtek Ethernet switch family support"
	depends on NET_DSA
	select FIXED_PHY
	select IRQ_DOMAIN
	select REALTEK_PHY
	select REGMAP
	help
	  Select to enable support for Realtek Ethernet switch chips.

	  Note that at least one interface driver must be enabled for the
	  subdrivers to be loaded. Moreover, an interface driver cannot achieve
	  anything without at least one subdriver enabled.

if NET_DSA_REALTEK

config NET_DSA_REALTEK_MDIO
	bool "Realtek MDIO interface support"
	depends on OF
	help
	  Select to enable support for registering switches configured
	  through MDIO.

config NET_DSA_REALTEK_SMI
	bool "Realtek SMI interface support"
	depends on OF
	help
	  Select to enable support for registering switches connected
	  through SMI.

config NET_DSA_REALTEK_RTL8365MB
	tristate "Realtek RTL8365MB switch driver"
	depends on NET_DSA_REALTEK_SMI || NET_DSA_REALTEK_MDIO
	select NET_DSA_TAG_RTL8_4
	help
	  Select to enable support for Realtek RTL8365MB-VC and RTL8367S.

config NET_DSA_REALTEK_RTL8366RB
	tristate "Realtek RTL8366RB switch driver"
	depends on NET_DSA_REALTEK_SMI || NET_DSA_REALTEK_MDIO
	select NET_DSA_TAG_RTL4_A
	help
	  Select to enable support for Realtek RTL8366RB.

config NET_DSA_REALTEK_RTL8366RB_LEDS
	bool
	depends on (LEDS_CLASS=y || LEDS_CLASS=NET_DSA_REALTEK_RTL8366RB)
	depends on NET_DSA_REALTEK_RTL8366RB
	default NET_DSA_REALTEK_RTL8366RB

endif

config RTL9602C_OPTICS_RO
	bool "RTL9602C: never write to the optics part"
	depends on NET_DSA_RTL9602C
	help
	  At every bring-up of the PON, the driver of the optics' laser
	  driver (PON_GN25L95) puts back the configuration the module loads
	  at power-up: its automatic extinction-ratio loop on, and the power
	  set point it found at its first bring-up. When the OLT asks for a
	  lower transmit power level, it lowers that set point, and it puts
	  the module's own level back at an orderly restart. These changes
	  are made so that the module does not store them: they last until
	  the module loses power.
	  To make them the driver shows the laser driver's configuration
	  table through A2h byte 127, the page select, which the module keeps
	  across a power cycle: it writes the byte only when it holds another
	  page, and writes it back as it was found. The adapter of the optics'
	  I2C master, which I2C_RTL9602C registers, passes those writes on
	  only for a module the switch driver has identified as one the laser
	  driver's code was measured on.

	  With this option the adapter refuses every write, from the laser
	  driver and from userspace through i2c-dev alike, so that nothing on
	  the board can change the module: no transmit power level, and the
	  "tables" debugfs view, which writes the page select, shows only the
	  table selected. The diagnostics read through hwmon and the debugfs
	  views that only read stay as they are.

	  Say Y for an image that must leave the module as it was found. A
	  loop turned off, or a lower set point left, by an earlier kernel
	  then stays so until the module loses power. If unsure, say N.

config NET_DSA_RTL9602C
	tristate "Realtek RTL9602C switch"
	depends on NET_DSA
	depends on HAS_IOMEM
	depends on I2C
	depends on PTP_1588_CLOCK_OPTIONAL
	depends on RTL9602C_ETH || !RTL9602C_ETH
	select AUXILIARY_BUS
	select MFD_SYSCON
	select NET_DSA_TAG_RTL9602C
	imply I2C_RTL9602C
	imply PON_RTL9602C
	help
	  DSA driver for the Ethernet switch of Realtek RTL9602C SoCs, the
	  chip of GPON ONUs such as SFP sticks. The switch has a SerDes port
	  to the host, the PON port and the CPU port, whose conduit is the
	  RTL9602C_ETH driver. Besides the switch itself (bridging, VLANs, the
	  address table, ACL and classifier rules, QoS, storm control and
	  L3/NAT offload). It also registers the switch's IEEE 1588 clock,
	  and decides whether the optics may be written, whose I2C master
	  has a driver of its own, I2C_RTL9602C, and their laser driver
	  another, such as PON_GN25L95. The chip's GPON MAC, with the PON
	  class's ONU, its OMCI channel and a network interface per GEM port,
	  has a driver of its own too, PON_RTL9602C, which this driver makes a
	  device for.

	  Say Y or M on an RTL9602C board. To compile this driver as a module,
	  choose M here: the module will be called rtl9602c.

config NET_DSA_RTL9602C_KUNIT_TEST
	bool "KUnit tests of the Realtek RTL9602C switch driver" if !KUNIT_ALL_TESTS
	depends on NET_DSA_RTL9602C && KUNIT=y
	default KUNIT_ALL_TESTS
	help
	  Build the KUnit tests of the driver's pure functions, the NAPT
	  hashes and the fields of the L3/NAT engine's table entries, into
	  the driver. They run when the driver is loaded.

	  If unsure, say N.
```

## linux/drivers/net/pon/Kconfig
```kconfig
# SPDX-License-Identifier: GPL-2.0-only

config PON
	tristate "Passive Optical Network (PON) ONU support"
	select NET_SWITCHDEV
	help
	  The class for drivers of optical network units (ONUs), the
	  subscriber end of a passive optical network such as G-PON. It gives
	  each ONU a PON device, ponN, and three interfaces to userspace:

	  - the character device /dev/ponNomci0, through which a management
	    daemon exchanges the messages of the ONU management and control
	    interface (OMCI, ITU-T G.988) with the OLT;
	  - the "gem" link kind, one network interface for each GEM port,
	    which carries the ONU's traffic and which management creates;
	  - the "pon" generic netlink family, which reports the ONU's
	    activation state, the identifiers the OLT assigned to it, its
	    alarms and counters, and its T-CONTs.

	  A GEM interface that joins a bridge is offloaded through switchdev,
	  so the class selects it.

	  The drivers of ONU MACs select this option, so it needs setting by
	  hand only to build the class without one. If unsure, say N.

	  To compile this as a module, choose M here: the module will be
	  called pon.

config PON_OMCI_INJECT
	bool "Inject OMCI messages through debugfs"
	depends on PON && DEBUG_FS
	help
	  Give each OMCI port a debugfs file, pon/ponNomci0/inject. A write
	  to it puts one OMCI message into the port as if the MAC had received
	  it from the OLT, so that the management daemon can be tested against
	  provisioning that the OLT at hand does not send. A process that can
	  write the file can make the daemon act as if the OLT had asked for
	  anything, so the option is for test images, not for an ONU in
	  service.

	  If unsure, say N.

config PON_SIM
	tristate "Stand-in ONU MAC for testing the PON class"
	depends on PON && DEBUG_FS
	help
	  A MAC driver with no hardware, for the tests of the PON class
	  (tools/testing/selftests/drivers/net/pon/). It registers an OMCI
	  port and a data path on a platform device of its own and an
	  interface, ponsim0, that carries the traffic of GEM interfaces; the
	  state it reports is set through debugfs, in the directory pon_sim.

	  If unsure, say N.

config PON_GN25L95
	tristate "Semtech GN25L95 PON laser driver"
	depends on PON && I2C
	depends on HWMON || HWMON=n
	help
	  The laser driver and limiting amplifier that runs the transmitter
	  and the receiver of a PON ONU's optics, on I2C, as on the ODI
	  DFP-34X-2C. The driver publishes the SFF-8472 diagnostics through
	  hwmon as "gn25l95", drives the transmitter's TX_DISABLE input, and
	  offers the optics to the ONU's MAC, which names them in the device
	  tree: before an activation it turns the part's automatic
	  extinction-ratio loop off, and it sets the transmit power levels the
	  MAC asks for. Those changes stay in the part's registers and last
	  until the part loses power. A bus that refuses writes leaves the
	  part as it is, and the driver then only reads it.

	  To compile this driver as a module, choose M here: the module will
	  be called gn25l95.

config PON_GN25L95_STORE
	bool "Store bytes of the GN25L95's configuration table through debugfs"
	depends on PON_GN25L95 && DEBUG_FS
	help
	  Give the part's debugfs directory a file, t2write, that stores
	  bytes of the laser driver's configuration table (table 2) in the
	  part's EEPROM, where they stay across every power cycle, and resets
	  the part. It puts right a module whose table 2 has gone wrong. Among
	  the bytes it takes are the transmitter's fault, alarm and rogue ONU
	  controls, which keep a faulty ONU from disturbing the other ONUs of
	  the PON, so a process that can write the file can weaken that
	  protection for good. The option is for test images, not for an ONU
	  in service.

	  If unsure, say N.

source "drivers/net/pon/rtl9602c/Kconfig"
```
