## br2-external/Config.in
```kconfig
# SPDX-License-Identifier: GPL-2.0-only
# SPDX-FileCopyrightText: 2026 Paweł Phan <szop.hektar_1w@icloud.com>
#
# The menu entries of this external tree. Each package recipe adds a line
#
#     source "$BR2_EXTERNAL_OPEN_DFP_34X_2C_PATH/package/<name>/Config.in"
#
# here.

source "$BR2_EXTERNAL_OPEN_DFP_34X_2C_PATH/package/omcid/Config.in"
source "$BR2_EXTERNAL_OPEN_DFP_34X_2C_PATH/package/onu-utils/Config.in"
source "$BR2_EXTERNAL_OPEN_DFP_34X_2C_PATH/package/pppoed/Config.in"
source "$BR2_EXTERNAL_OPEN_DFP_34X_2C_PATH/package/dhcp6d/Config.in"
source "$BR2_EXTERNAL_OPEN_DFP_34X_2C_PATH/package/timed/Config.in"
source "$BR2_EXTERNAL_OPEN_DFP_34X_2C_PATH/package/pond/Config.in"
source "$BR2_EXTERNAL_OPEN_DFP_34X_2C_PATH/package/libnl-tiny/Config.in"
source "$BR2_EXTERNAL_OPEN_DFP_34X_2C_PATH/package/netifd/Config.in"
source "$BR2_EXTERNAL_OPEN_DFP_34X_2C_PATH/package/procd/Config.in"
```

## br2-external/package/dhcp6d/Config.in
```kconfig
# SPDX-License-Identifier: GPL-2.0-only
# SPDX-FileCopyrightText: 2026 Paweł Phan <szop.hektar_1w@icloud.com>

config BR2_PACKAGE_DHCP6D
	bool "dhcp6d"
	depends on !BR2_STATIC_LIBS # libubox, ubus
	depends on BR2_TOOLCHAIN_HAS_SYNC_4 || BR2_mips_1 # json-c, ubus
	select BR2_PACKAGE_JSON_C
	select BR2_PACKAGE_LIBUBOX
	select BR2_PACKAGE_UBUS
	help
	  The IPv6 of a PPPoE session handed on: DHCPv6 prefix delegation
	  and router advertisements, from dhcp6d/ in this repository. It
	  publishes its state on ubus.
```

## br2-external/package/libnl-tiny/Config.in
```kconfig
# SPDX-License-Identifier: GPL-2.0-only
# SPDX-FileCopyrightText: 2026 Paweł Phan <szop.hektar_1w@icloud.com>

config BR2_PACKAGE_LIBNL_TINY
	bool "libnl-tiny"
	help
	  OpenWrt's small netlink library, a subset of libnl, which
	  netifd is written against. It is built for linking only:
	  netifd takes it in statically, and the image holds no copy
	  of its own.

	  https://git.openwrt.org/?p=project/libnl-tiny.git
```

## br2-external/package/netifd/Config.in
```kconfig
# SPDX-License-Identifier: GPL-2.0-only
# SPDX-FileCopyrightText: 2026 Paweł Phan <szop.hektar_1w@icloud.com>

config BR2_PACKAGE_NETIFD
	bool "netifd"
	depends on !BR2_STATIC_LIBS # libubox, libuci, ubus
	depends on BR2_TOOLCHAIN_HAS_SYNC_4 || BR2_mips_1 # json-c, ubus
	select BR2_PACKAGE_JSON_C
	select BR2_PACKAGE_LIBNL_TINY
	select BR2_PACKAGE_LIBUBOX
	select BR2_PACKAGE_LIBUCI
	select BR2_PACKAGE_UBUS
	help
	  The network interface daemon of OpenWrt, from the fork in
	  netifd/ of this repository: it brings up the links, VLANs
	  and bridges and gives them their addresses and routes, as
	  its configuration says, and takes what other programs report
	  over ubus.
```

## br2-external/package/omcid/Config.in
```kconfig
# SPDX-License-Identifier: GPL-2.0-only
# SPDX-FileCopyrightText: 2026 Paweł Phan <szop.hektar_1w@icloud.com>

config BR2_PACKAGE_OMCID
	bool "omcid"
	depends on !BR2_STATIC_LIBS # libubox, ubus
	depends on BR2_TOOLCHAIN_HAS_SYNC_4 || BR2_mips_1 # ubus
	select BR2_PACKAGE_LIBUBOX
	select BR2_PACKAGE_UBUS
	help
	  The OMCI daemon of the ONU, from omcid/ in this repository:
	  it answers the OLT and programs the data path through the
	  kernel's interfaces, and publishes what the OLT set up on
	  ubus. Installs /usr/sbin/omcid and the tools omcitap and
	  omcivlan, which the board's post-build script sets aside for
	  the RAM image.
```

## br2-external/package/onu-utils/Config.in
```kconfig
# SPDX-License-Identifier: GPL-2.0-only
# SPDX-FileCopyrightText: 2026 Paweł Phan <szop.hektar_1w@icloud.com>

config BR2_PACKAGE_ONU_UTILS
	bool "onu-utils"
	depends on !BR2_STATIC_LIBS # libubox, ubus
	depends on BR2_TOOLCHAIN_HAS_SYNC_4 || BR2_mips_1 # json-c, ubus
	select BR2_PACKAGE_JSON_C
	select BR2_PACKAGE_LIBMNL
	select BR2_PACKAGE_LIBUBOX
	select BR2_PACKAGE_UBUS
	select BR2_PACKAGE_ZLIB
	help
	  The small programs of the ONU, from onu-utils/ in this
	  repository: ponid, which prints the identity of the unit
	  from its factory configuration; pon, which shows the PON
	  devices and their ONU as the kernel reports them; and
	  onu-mode, which puts the stick in bridge or router mode.
```

## br2-external/package/pond/Config.in
```kconfig
# SPDX-License-Identifier: GPL-2.0-only
# SPDX-FileCopyrightText: 2026 Paweł Phan <szop.hektar_1w@icloud.com>

config BR2_PACKAGE_POND
	bool "pond"
	depends on !BR2_STATIC_LIBS # libubox, ubus
	depends on BR2_TOOLCHAIN_HAS_SYNC_4 # json-c, ubus
	select BR2_PACKAGE_JSON_C
	select BR2_PACKAGE_LIBMNL
	select BR2_PACKAGE_LIBUBOX
	select BR2_PACKAGE_UBUS
	select BR2_PACKAGE_HOST_NODEJS
	help
	  The HTTP daemon of the ONU and its panel, from pond/ in this
	  repository: the state of the device as JSON, the settings,
	  and a single-page app built with the host's Node. It reads
	  the state of the stick's programs on ubus.
```

## br2-external/package/pppoed/Config.in
```kconfig
# SPDX-License-Identifier: GPL-2.0-only
# SPDX-FileCopyrightText: 2026 Paweł Phan <szop.hektar_1w@icloud.com>

config BR2_PACKAGE_PPPOED
	bool "pppoed"
	depends on !BR2_STATIC_LIBS # libubox, ubus
	depends on BR2_TOOLCHAIN_HAS_SYNC_4 # json-c, ubus
	select BR2_PACKAGE_JSON_C
	select BR2_PACKAGE_LIBUBOX
	select BR2_PACKAGE_UBUS
	help
	  The PPPoE client of the ONU, from pppoed/ in this repository,
	  and netifd's protocol "pppoed", which it tells over ubus.
```

## br2-external/package/procd/Config.in
```kconfig
# SPDX-License-Identifier: GPL-2.0-only
# SPDX-FileCopyrightText: 2026 Paweł Phan <szop.hektar_1w@icloud.com>

config BR2_PACKAGE_PROCD
	bool "procd"
	depends on !BR2_STATIC_LIBS # libubox, ubus
	depends on BR2_TOOLCHAIN_HAS_SYNC_4 # json-c, ubus
	select BR2_PACKAGE_JSON_C
	select BR2_PACKAGE_LIBUBOX
	select BR2_PACKAGE_UBUS
	help
	  OpenWrt's init and service supervisor: the first process,
	  which feeds the watchdog, starts ubusd and the programs of
	  /etc/inittab and starts them again when they end.

	  https://git.openwrt.org/?p=project/procd.git
```

## br2-external/package/timed/Config.in
```kconfig
# SPDX-License-Identifier: GPL-2.0-only
# SPDX-FileCopyrightText: 2026 Paweł Phan <szop.hektar_1w@icloud.com>

config BR2_PACKAGE_TIMED
	bool "timed"
	help
	  The clock of the stick, set from the host: an NTP client and a
	  PTP slave in one daemon, which sets the clock from the better of
	  the two that answer, and from the date the OLT gives when the
	  host gives none. From timed/ in this repository.
```

## linux/Documentation/devicetree/bindings/interrupt-controller/realtek,rtl9602c-intc.yaml
```yaml
# SPDX-License-Identifier: (GPL-2.0-only OR BSD-2-Clause)
%YAML 1.2
---
$id: http://devicetree.org/schemas/interrupt-controller/realtek,rtl9602c-intc.yaml#
$schema: http://devicetree.org/meta-schemas/core.yaml#

title: Realtek RTL9602C interrupt controller

maintainers:
  - Paweł Phan <szop.hektar_1w@icloud.com>

description: |
  The interrupt controller of the Realtek RTL9602C sits between the SoC's
  peripherals and the CPU's interrupt lines. It takes 64 sources in two banks
  of 32, each bank with an enable and a status register. A status bit is set
  while its source asserts, whether the source is enabled or not, and clears
  when the device that raised it is serviced: there is no acknowledge
  register, and the sources are level-sensitive.

  Sources 32 to 63 reach the CPU only while source 12 of the lower bank is
  enabled as well, and the status bit of source 12 is set while any of them is
  pending.

  Routing registers in the controller, not the wiring, select the CPU
  interrupt line the sources are delivered on, so the node has the CPU's
  interrupt controller as its parent but no interrupts property.

properties:
  compatible:
    const: realtek,rtl9602c-intc

  reg:
    maxItems: 1

  interrupt-controller: true

  '#interrupt-cells':
    description: The source number, 0 to 63.
    const: 1

required:
  - compatible
  - reg
  - interrupt-controller
  - '#interrupt-cells'

additionalProperties: false

examples:
  - |
    interrupt-controller@18003000 {
        compatible = "realtek,rtl9602c-intc";
        reg = <0x18003000 0x100>;
        interrupt-controller;
        #interrupt-cells = <1>;
        interrupt-parent = <&cpuintc>;
    };
```

## linux/Documentation/devicetree/bindings/mips/realtek-rtl9602c.yaml
```yaml
# SPDX-License-Identifier: (GPL-2.0-only OR BSD-2-Clause)
%YAML 1.2
---
$id: http://devicetree.org/schemas/mips/realtek-rtl9602c.yaml#
$schema: http://devicetree.org/meta-schemas/core.yaml#

title: Realtek RTL9602C based boards

maintainers:
  - Paweł Phan <szop.hektar_1w@icloud.com>

description:
  The Realtek RTL9602C is a SoC for GPON optical network units (ONUs). Its CPU
  is one Lexra LX5281, a big-endian MIPS I core, and its GPON MAC sits behind
  the PON port of its Ethernet switch. The ODI DFP-34X-2C3 is a GPON ONU in an
  SFP module, built on this SoC.

properties:
  $nodename:
    const: '/'

  compatible:
    oneOf:
      - description: Boards with the Realtek RTL9602C
        items:
          - enum:
              - odi,dfp-34x-2c3
          - const: realtek,rtl9602c

additionalProperties: true

examples:
  - |
    / {
        compatible = "odi,dfp-34x-2c3", "realtek,rtl9602c";
        model = "ODI DFP-34X-2C3";
        #address-cells = <1>;
        #size-cells = <1>;

        cpus {
            #address-cells = <1>;
            #size-cells = <0>;

            cpu@0 {
                device_type = "cpu";
                compatible = "lexra,lx5281";
                reg = <0>;
            };
        };
    };
```

## linux/Documentation/devicetree/bindings/net/dsa/realtek,rtl9602c-switch.yaml
```yaml
# SPDX-License-Identifier: (GPL-2.0-only OR BSD-2-Clause)
%YAML 1.2
---
$id: http://devicetree.org/schemas/net/dsa/realtek,rtl9602c-switch.yaml#
$schema: http://devicetree.org/meta-schemas/core.yaml#

title: Realtek RTL9602C Ethernet switch

maintainers:
  - Paweł Phan <szop.hektar_1w@icloud.com>

description: |
  The Ethernet switch of the Realtek RTL9602C, a SoC for GPON optical network
  units (ONUs). Its register window also holds the chip's GPON MAC, the PON
  MAC with its packet buffer, an L3/NAT forwarding engine, an IEEE 1588 clock
  and two I2C masters.

  The switch has four ports. Port 0 is a SerDes lane to the host, 1000BASE-X
  or 2500BASE-X; port 1 exists in the silicon and is left out where it is not
  wired; port 2 is the PON port, behind which the GPON MAC sits; port 3 is the
  CPU port, whose conduit is the CPU port's DMA engine (realtek,rtl9602c-eth).
  Ports 0, 2 and 3 have no PHY and are described as fixed links.

  The PON MAC needs the system controller and the two DRAM areas of its packet
  buffer, given by realtek,sysctl and memory-region.

  The optics of the ONU, a laser driver such as the Semtech GN25L95, sit on the
  bus of the I2C master that the i2c node describes, and the GPON MAC drives
  the optics that realtek,pon-optics names.

$ref: /schemas/net/dsa/dsa.yaml#

properties:
  compatible:
    const: realtek,rtl9602c-switch

  reg:
    description:
      The register window of the switch and of the other blocks named above.
    maxItems: 1

  interrupts:
    description:
      The output of the switch's interrupt block, which all of its sources
      share, the GPON MAC's included.
    maxItems: 1

  i2c:
    $ref: /schemas/i2c/i2c-controller.yaml#
    unevaluatedProperties: false
    description:
      The I2C master of the optics, one of the two that the register window
      holds. The devices on its bus, the optics' laser driver, are its
      children.

  realtek,pon-optics:
    description:
      The optics that the GPON MAC drives, a laser driver on the bus of the
      i2c node.
    $ref: /schemas/types.yaml#/definitions/phandle

  realtek,sysctl:
    description:
      The system controller, a syscon. It holds the enable in front of the PON
      MAC and its packet buffer; until that is set, no access to them
      completes.
    $ref: /schemas/types.yaml#/definitions/phandle

  memory-region:
    description:
      The DRAM areas the PON MAC's packet buffer spills into, one per
      direction and each at least 1 MiB. The PON MAC reads and writes them by
      DMA and the CPU never touches them, so they are reserved and no-map.
    items:
      - description: the upstream area
      - description: the downstream area

  memory-region-names:
    items:
      - const: pbo-us
      - const: pbo-ds

required:
  - compatible
  - reg
  - interrupts

dependentRequired:
  memory-region: [ "realtek,sysctl", memory-region-names ]

unevaluatedProperties: false

examples:
  - |
    #include <dt-bindings/gpio/gpio.h>

    switch@1b000000 {
        compatible = "realtek,rtl9602c-switch";
        reg = <0x1b000000 0xf10000>;
        interrupt-parent = <&intc>;
        interrupts = <8>;
        realtek,sysctl = <&sysctl>;
        realtek,pon-optics = <&laser>;
        memory-region = <&pbo_us>, <&pbo_ds>;
        memory-region-names = "pbo-us", "pbo-ds";

        i2c {
            #address-cells = <1>;
            #size-cells = <0>;

            laser: laser-driver@50 {
                compatible = "semtech,gn25l95";
                reg = <0x50>;
                tx-disable-gpios = <&gpio0 13 GPIO_ACTIVE_HIGH>;
            };
        };

        ethernet-ports {
            #address-cells = <1>;
            #size-cells = <0>;

            port@0 {
                reg = <0>;
                label = "sfp";
                phy-mode = "2500base-x";

                fixed-link {
                    speed = <2500>;
                    full-duplex;
                };
            };

            port@3 {
                reg = <3>;
                ethernet = <&eth>;
                phy-mode = "internal";

                fixed-link {
                    speed = <1000>;
                    full-duplex;
                };
            };
        };
    };
```

## linux/Documentation/devicetree/bindings/net/realtek,rtl9602c-eth.yaml
```yaml
# SPDX-License-Identifier: (GPL-2.0-only OR BSD-2-Clause)
%YAML 1.2
---
$id: http://devicetree.org/schemas/net/realtek,rtl9602c-eth.yaml#
$schema: http://devicetree.org/meta-schemas/core.yaml#

title: Realtek RTL9602C switch CPU port DMA engine

maintainers:
  - Paweł Phan <szop.hektar_1w@icloud.com>

description: |
  The CPU port of the Realtek RTL9602C's Ethernet switch, port 3 of
  realtek,rtl9602c-switch, has no MAC behind it: a DMA engine moves frames
  between memory and the switch through descriptor rings. What the switch and
  the CPU tell each other about a frame travels in its descriptor, not in the
  frame: on transmit the destination port, a priority and a PON flow; on
  receive the source port, the reason the switch sent the frame to the CPU
  and the PON flow it arrived on.

  The switch's CPU port refers to this node through its ethernet property.
  The engine's address registers hold the unit's MAC address, which the boot
  loader leaves there.

properties:
  $nodename:
    pattern: "^ethernet@[0-9a-f]+$"

  compatible:
    const: realtek,rtl9602c-eth

  reg:
    maxItems: 1

  interrupts:
    maxItems: 1

required:
  - compatible
  - reg
  - interrupts

additionalProperties: false

examples:
  - |
    ethernet@18012000 {
        compatible = "realtek,rtl9602c-eth";
        reg = <0x18012000 0x1440>;
        interrupt-parent = <&intc>;
        interrupts = <26>;
    };
```
